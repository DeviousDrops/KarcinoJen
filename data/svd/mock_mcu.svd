# MockMCU register map
Registers are 32-bit, access not given, no defined reset value unless marked. A register's access mark holds for its fields unless they carry their own. Offsets are from the block's base; lines under a group give offsets from that group; [hi:lo] are bit positions; {n}, {i} and the like mark numbered series; 'fields as' and 'values as' point back to an identical list; <NAME> marks a mode.

## Memory map
0x40004400 USART2
0x40005400 I2C1

## USART2
Base 0x40004400
0x00 USART_CR1

## I2C1
Base 0x40005400
0x00 I2C_CR1
